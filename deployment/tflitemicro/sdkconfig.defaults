## deployment/tflitemicro/sdkconfig.defaults
```kconfig
# ESP32-S3 16 MB OTA deployment defaults.
# Regenerate sdkconfig with `idf.py set-target esp32s3` / `idf.py reconfigure`
# after changing defaults.
CONFIG_IDF_TARGET="esp32s3"
CONFIG_IDF_TARGET_ESP32S3=y

# Hardware flash size.
CONFIG_ESPTOOLPY_FLASHSIZE_16MB=y
CONFIG_ESPTOOLPY_FLASHSIZE="16MB"

# Use the custom A/B OTA firmware + A/B model partition table.
CONFIG_PARTITION_TABLE_CUSTOM=y
CONFIG_PARTITION_TABLE_CUSTOM_FILENAME="partitions_ota_16mb.csv"
CONFIG_PARTITION_TABLE_FILENAME="partitions_ota_16mb.csv"
CONFIG_PARTITION_TABLE_OFFSET=0x8000
CONFIG_PARTITION_TABLE_MD5=y

# Enable bootloader-controlled app rollback for failed first-boot self-tests.
CONFIG_BOOTLOADER_APP_ROLLBACK_ENABLE=y

# The classifier tensor arena is larger than available internal DRAM.
# Use external PSRAM for TensorFlow Lite Micro allocations on ESP32-S3 modules
# with octal PSRAM, such as common N8R8 boards.
CONFIG_SPIRAM=y
CONFIG_SPIRAM_MODE_OCT=y
CONFIG_SPIRAM_TYPE_AUTO=y
CONFIG_SPIRAM_BOOT_INIT=y
CONFIG_SPIRAM_USE_CAPS_ALLOC=y
CONFIG_SPIRAM_SPEED_80M=y
CONFIG_SPIRAM_MEMTEST=y
```
